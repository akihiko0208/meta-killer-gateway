## conf/distro/happy-signage.conf
```bitbake
# conf/distro/happy-signage.conf
DISTRO = "happy-signage"
DISTRO_NAME = "Happy Signage Distro"
DISTRO_VERSION = "1.0"

# systemd & wayland
DISTRO_FEATURES:append = " wayland opengl pam systemd usrmerge"
DISTRO_FEATURES:remove = " x11 pulseaudio "

VIRTUAL-RUNTIME_init_manager = "systemd"
VIRTUAL-RUNTIME_initscripts = ""
DISTRO_FEATURES_BACKFILL_CONSIDERED = "sysvinit x11"

IMAGE_LINGUAS ?= "en-us"
PACKAGECONFIG:append:pn-chromium = " ozone wayland"
```

## conf/distro/signage.conf
```bitbake
DISTRO = "signage"
DISTRO_NAME = "Signage Distro"
DISTRO_VERSION = "1.0"

DISTRO_FEATURES:append = " systemd wifi bluetooth pam wayland"
VIRTUAL-RUNTIME_init_manager = "systemd"

IMAGE_INSTALL:append = " tzdata chrony ca-certificates connman"
TIMEZONE = "Asia/Tokyo"

EXTRA_IMAGE_FEATURES += " ssh-server-openssh"
IMAGE_FSTYPES += " tar.xz wic.bz2 wic.bmap"
```

## conf/layer.conf
```bitbake
# ============================================================
# meta-happy-signage layer configuration
# ============================================================
BBPATH .= ":${LAYERDIR}"
BBFILES += "${LAYERDIR}/recipes-*/*/*.bb \
            ${LAYERDIR}/recipes-*/*/*.bbappend"

BBFILE_COLLECTIONS += "happy-signage"
BBFILE_PATTERN_happy-signage := "^${LAYERDIR}/"
BBFILE_PRIORITY_happy-signage = "7"

# Dependency layers
LAYERDEPENDS_happy-signage = "core openembedded-layer raspberrypi chromium-browser-layer"

# Yoctoリリース整合性（使っている系列に合わせて調整）
LAYERSERIES_COMPAT_happy-signage = "kirkstone nanbield scarthgap walnascar whinlatter"
```
